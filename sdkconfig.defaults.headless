## src/Kconfig.projbuild
```kconfig
menu "Printer server"

    config PRINTER_DRIVER
        string "Printer driver"
        default "canon-mg2500"
        help
            The id of the printer model the firmware drives until a printer
            is plugged in, and for a printer it does not recognise, from
            components/printers/printers.c. A recognised printer (USB id or
            IEEE 1284 model name) uses its own driver.

    choice PRINTER_RESOLUTION
        prompt "Test page resolution"
        default PRINTER_RES_600
        help
            Canon plain-paper print mode used for the test page.
        config PRINTER_RES_300
            bool "300x300 dpi (fast, CMYK 1 bit)"
        config PRINTER_RES_600
            bool "600x600 dpi (standard, C/M 3-level)"
    endchoice

    config STATUS_LED_GPIO
        int "WS2812 status LED GPIO"
        default 48

    config STATUS_LED_BRIGHTNESS
        int "Status LED brightness (percent)"
        range 1 100
        default 10

    config PRINT_BUTTON_GPIO
        int "Print button GPIO (active low)"
        default 0

    config PRINT_BUTTON2_GPIO
        int "Second print button GPIO (same as BOOT, active low, -1 = none)"
        default 4

    config USER_BUTTON_GPIO
        int "User button GPIO (no action assigned: on_user_button in main.c; active low, -1 = none)"
        default 5

    config OLED_SDA_GPIO
        int "Status screen (I2C OLED) SDA GPIO"
        default 42

    config OLED_SCL_GPIO
        int "Status screen (I2C OLED) SCL GPIO"
        default 41

    choice OLED_CONTROLLER
        prompt "Status screen controller"
        default OLED_SSD1306
        help
            0.96" 128x64 modules are usually SSD1306, 1.3" ones SH1106
            (on an SSD1306 setting, an SH1106 shows a 2-pixel column of
            noise at one edge).
        config OLED_SSD1306
            bool "SSD1306"
        config OLED_SH1106
            bool "SH1106"
    endchoice

    config OLED_FLIP
        bool "Rotate the status screen by 180 degrees"
        default n

    config OLED_SLEEP_MIN
        int "Turn the status screen off after this many minutes without change (0 = never)"
        range 0 1440
        default 10
        help
            OLED pixels that stay lit for months burn in. Any change on the
            screen or a press of the button turns it back on.

    config USB_HOST_DELAY_S
        int "Seconds the USB port stays USB-Serial/JTAG before it becomes the printer host"
        range 0 120
        default 15
        help
            The reflash window of a board whose only USB port is the one the
            printer uses (Lily Touch). A board with a separate USB-UART port
            (YD-ESP32-S3, ESP32-S3-CAM: "COM"/"TTL") is flashed there and
            needs no window.

    config USB_MODE_BUTTON_A_GPIO
        int "Hold 2 s to switch USB print/flash mode: first button GPIO (-1 = none)"
        default 39

    config USB_MODE_BUTTON_B_GPIO
        int "Hold 2 s to switch USB print/flash mode: second button GPIO (-1 = none)"
        default 40

    config LCD_NV3023
        bool "NV3023 colour status screen (ostb-xiaozhi-3st / Lily Touch board)"
        default n

    config LCD_BATTERY_ADC_GPIO
        int "Battery voltage ADC GPIO (-1 = log GPIO1..3 to find it)"
        depends on LCD_NV3023
        default -1

    config LCD_BATTERY_DIVIDER_X100
        int "Battery voltage divider ratio x100 (200 = 1:2)"
        depends on LCD_NV3023
        default 200

    config LCD_CHARGING_LEVEL
        int "GPIO47 level while charging (0 or 1)"
        depends on LCD_NV3023
        range 0 1
        default 1

    config LCD_MADCTL
        hex "NV3023 MADCTL (0x60 = landscape, 0xA0 = landscape turned 180)"
        depends on LCD_NV3023
        default 0x60

    config LCD_BACKLIGHT_OFF_MIN
        int "Backlight off after this many minutes without change (0 = never)"
        depends on LCD_NV3023
        default 3

endmenu
```
